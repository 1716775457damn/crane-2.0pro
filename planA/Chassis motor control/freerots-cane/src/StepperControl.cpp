#include "StepperControl.h"

/**
 * @brief 初始化步进电机
 */
void initSteppers() {
    // 配置步进电机1引脚
    pinMode(SLEEP1, OUTPUT);
    pinMode(DIR1, OUTPUT);
    
    // 配置步进电机2引脚
    pinMode(SLEEP2, OUTPUT);
    pinMode(DIR2, OUTPUT);
    
    // 初始状态：不休眠（启用）
    digitalWrite(SLEEP1, HIGH);
    digitalWrite(SLEEP2, HIGH);
    
    // 设置初始方向为顺时针
    digitalWrite(DIR1, DIR_CW);
    digitalWrite(DIR2, DIR_CW);
    
    // 初始速度设为0（停止）
    analogWrite(STEP1, 0);
    analogWrite(STEP2, 0);
}

/**
 * @brief 控制单个电机运行
 * @param motorNumber 电机编号 (1 或 2)
 * @param direction 方向 (DIR_CW 或 DIR_CCW)
 * @param speed PWM速度值 (0-255)
 */
void moveMotor(uint8_t motorNumber, bool direction, uint8_t speed) {
    // 检查电机编号
    if (motorNumber != 1 && motorNumber != 2) {
        return;
    }
    
    // 确定引脚
    uint8_t sleepPin = (motorNumber == 1) ? SLEEP1 : SLEEP2;
    uint8_t dirPin = (motorNumber == 1) ? DIR1 : DIR2;
    uint8_t stepPin = (motorNumber == 1) ? STEP1 : STEP2;
    
    // 唤醒电机
    digitalWrite(sleepPin, HIGH);
    
    // 设置方向
    digitalWrite(dirPin, direction);
    
    // 设置速度
    analogWrite(stepPin, speed);
}

/**
 * @brief 停止电机
 * @param motorNumber 电机编号 (1 或 2)
 */
void stopMotor(uint8_t motorNumber) {
    // 检查电机编号
    if (motorNumber != 1 && motorNumber != 2) {
        return;
    }
    
    // 确定引脚
    uint8_t stepPin = (motorNumber == 1) ? STEP1 : STEP2;
    uint8_t sleepPin = (motorNumber == 1) ? SLEEP1 : SLEEP2;
    
    // 停止电机
    analogWrite(stepPin, 0);
    
    // 让电机进入睡眠状态
    digitalWrite(sleepPin, LOW);
}

/**
 * @brief 单行控制函数 - 根据预设模式控制两个电机
 * @param movePattern 移动模式 (MOVE_FORWARD, MOVE_BACKWARD, TURN_LEFT, TURN_RIGHT, STOP)
 * @param speed PWM速度值 (0-255)
 */
void moveSteppers(uint8_t movePattern, uint8_t speed) {
    switch (movePattern) {
        case MOVE_FORWARD:
            // 两个电机都正向旋转
            moveMotor(1, DIR_CW, speed);
            moveMotor(2, DIR_CW, speed);
            break;
            
        case MOVE_BACKWARD:
            // 两个电机都反向旋转
            moveMotor(1, DIR_CCW, speed);
            moveMotor(2, DIR_CCW, speed);
            break;
            
        case TURN_LEFT:
            // 左电机反转，右电机正转
            moveMotor(1, DIR_CCW, speed);
            moveMotor(2, DIR_CW, speed);
            break;
            
        case TURN_RIGHT:
            // 左电机正转，右电机反转
            moveMotor(1, DIR_CW, speed);
            moveMotor(2, DIR_CCW, speed);
            break;
            
        case STOP:
            // 停止两个电机
            stopMotor(1);
            stopMotor(2);
            break;
            
        default:
            // 默认停止
            stopMotor(1);
            stopMotor(2);
            break;
    }
}
